## esp_emulator/sdkconfig.defaults
```kconfig
# Target: Seeed XIAO ESP32-C6 (ESP32-C6 RISC-V, 4 MB flash, BLE 5.3)
CONFIG_IDF_TARGET="esp32c6"

# Flash
CONFIG_ESPTOOLPY_FLASHSIZE_4MB=y
CONFIG_ESPTOOLPY_FLASHSIZE="4MB"

# Custom partitions (scaled to 4 MB)
CONFIG_PARTITION_TABLE_CUSTOM=y
CONFIG_PARTITION_TABLE_CUSTOM_FILENAME="partitions.csv"
CONFIG_PARTITION_TABLE_FILENAME="partitions.csv"

# Console via native USB Serial/JTAG
CONFIG_ESP_CONSOLE_USB_SERIAL_JTAG=y

# Bluetooth — NimBLE peripheral (BLE 5.3 on C6)
CONFIG_BT_ENABLED=y
CONFIG_BT_NIMBLE_ENABLED=y
CONFIG_BT_CONTROLLER_ENABLED=y
CONFIG_BT_NIMBLE_ROLE_PERIPHERAL=y
CONFIG_BT_NIMBLE_ROLE_CENTRAL=n
CONFIG_BT_NIMBLE_ROLE_OBSERVER=n
CONFIG_BT_NIMBLE_ROLE_BROADCASTER=n
CONFIG_BT_NIMBLE_MAX_CONNECTIONS=1

# Increase NimBLE host task stack to avoid overflow during RC4 decrypt
# inside GATT write callbacks (default 4096 is too small)
CONFIG_BT_NIMBLE_TASK_STACK_SIZE=8192

# Security Manager — Just Works, bonding, Secure Connections
CONFIG_BT_NIMBLE_SM_SC=y
CONFIG_BT_NIMBLE_SM_LEGACY=y
CONFIG_BT_NIMBLE_NVS_PERSIST=y
CONFIG_BT_NIMBLE_MAX_BONDS=5

# Maximum TX power (BLE default is usually P6 / +9 dBm). Force max P9 = +20 dBm.
CONFIG_BT_CTRL_DFT_TX_POWER_LEVEL_P9=y

# Logging
CONFIG_LOG_DEFAULT_LEVEL_INFO=y

# FreeRTOS 1 kHz tick
CONFIG_FREERTOS_HZ=1000

# WiFi: move code to Flash to free IRAM
CONFIG_ESP_WIFI_IRAM_OPT=n
CONFIG_ESP_WIFI_RX_IRAM_OPT=n

# BLE + WiFi coexistence
CONFIG_ESP_COEX_SW_COEXIST_ENABLE=y

# HTTP server tuned for OTA uploads
CONFIG_HTTPD_MAX_REQ_HDR_LEN=1024
CONFIG_HTTPD_MAX_URI_LEN=256

# OTA — enable app rollback on bad firmware
CONFIG_BOOTLOADER_APP_ROLLBACK_ENABLE=y

# Raise app main task stack
CONFIG_ESP_MAIN_TASK_STACK_SIZE=6144
```
